## conf/layer.conf
```bitbake
# We have a conf and classes directory, add to BBPATH
BBPATH .= ":${LAYERDIR}"

# We have recipes-* directories, add to BBFILES
BBFILES += "${LAYERDIR}/recipes-*/*/*.bb \
            ${LAYERDIR}/recipes-*/*/*.bbappend"

BBFILE_COLLECTIONS += "meta-rbxos"
BBFILE_PATTERN_meta-rbxos = "^${LAYERDIR}/"
BBFILE_PRIORITY_meta-rbxos = "20"

LAYERDEPENDS_meta-rbxos = "core"
LAYERSERIES_COMPAT_meta-rbxos = "honister"
```

## wic/rbxos-cn9130-cf-base-sdcard.wks
```
# short-description: Creates SD card image for rbxos
# long-description: Creates SD card image for rbxos
part --source rawcopy --sourceparams="file=flash-image.bin" --no-table --offset 2M
part --source bootimg-partition --fstype=vfat --offset=64M --fixed-size=64M
part --source bootimg-partition --fstype=vfat --fixed-size=64M
part --source rootfs --fstype squashfs --align 4 --type logical --fixed-size=1990M
part --source rootfs --fstype squashfs --align 4 --type logical --fixed-size=1990M
part --fstype=ext4 --align 4 --type logical --fixed-size=1990M
part --fstype=ext4 --align 4 --type logical --fixed-size=1990M
```
